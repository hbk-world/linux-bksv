## Documentation/devicetree/bindings/misc/ti,dac8560.txt
```
TI DAC8560 DEVICETREE BINDINGS

Required properties:

	- "compatible"		Must be set to "ti,dac8560"

Property rules described in Documentation/devicetree/bindings/spi/spi-bus.txt
apply. In particular, "reg" and "spi-max-frequency" properties must be given.


Optional properties:
- init-val : sets the dac value when DAC8560 is probed (0-65535).

Example:

	spi_master {
		dac8560: dac8560@0 {
			compatible = "ti,dac8560";
			reg = <0>; /* CS0 */
			spi-max-frequency = <1000000>;
            init-val = <32767>;
		};
	};
```

## drivers/bksv/Kconfig
```kconfig
config BKSV
	bool "Analog driver"
	depends on I2C
	depends on USB
	depends on CHARGER_BQ25890
	select REGMAP_I2C
 	help
	  Bksv sai if.
```
